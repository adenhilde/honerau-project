## honerau-project_attempttoencrypt/etc/conf/local.conf
```bitbake
MACHINE ??= "ls1088ardb-pb"
DISTRO ?= "fsl-qoriq"

EXTRA_IMAGE_FEATURES ?= "allow-empty-password empty-root-password allow-root-login"
USER_CLASSES ?= "buildstats"
PATCHRESOLVE = "noop"
CONF_VERSION = "2"

BB_DISKMON_DIRS ??= "\
    STOPTASKS,${TMPDIR},1G,100K \
    STOPTASKS,${DL_DIR},1G,100K \
    STOPTASKS,${SSTATE_DIR},1G,100K \
    STOPTASKS,/tmp,100M,100K \
    HALT,${TMPDIR},100M,1K \
    HALT,${DL_DIR},100M,1K \
    HALT,${SSTATE_DIR},100M,1K \
    HALT,/tmp,10M,1K"

PACKAGECONFIG:append:pn-qemu-system-native = " sdl"

DL_DIR = "/home/aaron/yocto-sdk/downloads"
SSTATE_DIR = "/home/aaron/yocto-sdk/sstate-cache"
INITRAMFS_IMAGE = "core-image-minimal"

ACCEPT_FSL_EULA = "1"

# ------------------------------------------------------------
# Custom additions (Aaron)
# ------------------------------------------------------------

PACKAGE_CLASSES = "package_ipk"
IMAGE_FEATURES:append = " package-management"

# Enable Wi-Fi + Bluetooth stacks
DISTRO_FEATURES:append = " wifi bluetooth"

# IMPORTANT: do NOT enable systemd here (it breaks udev provider due to usrmerge)
# Force sysvinit
VIRTUAL-RUNTIME_init_manager = "sysvinit"

# BlueZ tools naming compatibility
PREFERRED_RPROVIDER_bluez5-tools = "bluez-tools"

IMAGE_INSTALL:append = " \
    hostapd iptables \
    openssh-sshd openssh-sftp-server \
    vim tmux \
    nginx modemmanager \
    linux-firmware \
    \
    bluez5 bluez-tools \
    dbus dbus-dev \
    glib-2.0 glib-2.0-dev \
    dbus-glib dbus-glib-dev \
    \
    i2c-tools python3 \
    openssl openssl-dev ca-certificates \
    openssl-provider-se050 freeradius \
    \
    packagegroup-core-buildessential \
    cmake git pkgconfig \
    wget curl curl-dev net-tools \
    \
    util-linux-libuuid util-linux-libuuid-dev \
    c-ares c-ares-dev \
    cyrus-sasl cyrus-sasl-dev \
    libwebsockets libwebsockets-dev \
    mosquitto mosquitto-clients \
"
```
